/*
 * N32H7xx XIP-to-TCM SoC startup support (Keil/ARMCC version)
 *
 * This file replaces Keil's library __main with our own implementation.
 * Boot flow: Reset_Handler -> SystemInit -> lowlevel_init -> __main -> main()
 *
 * __main does:
 *   - Relocate RW_ITCM from FLASH to ITCM
 *   - Copy .data from FLASH to AHB_SRAM
 *   - Zero .bss in AHB_SRAM
 *   - Switch VTOR to ITCM and set MSP to AXI_SRAM top
 *   - Jump to main()
 */

#include <stdint.h>
#include "n32h7xx.h"

/* ---- Scatter-loading symbols (generated by armlink from link.sct) ---- */

/* RW_ITCM: vector table + code + read-only data copied from FLASH to ITCM */
extern uint32_t Load$$RW_ITCM$$Base;
extern uint32_t Image$$RW_ITCM$$Base;
extern uint32_t Image$$RW_ITCM$$Length;

/* RW_AHB_SRAM: .data (RW) — initialized data copied from FLASH */
extern uint32_t Load$$RW_AHB_SRAM$$RW$$Base;
extern uint32_t Image$$RW_AHB_SRAM$$RW$$Base;
extern uint32_t Image$$RW_AHB_SRAM$$RW$$Limit;

/* RW_AHB_SRAM: .bss (ZI) — zero-initialized data */
extern uint32_t Image$$RW_AHB_SRAM$$ZI$$Base;
extern uint32_t Image$$RW_AHB_SRAM$$ZI$$Limit;

/* RW_AXI_SRAM: stack + heap — we need the region end for MSP */
/* Stack top — comes from startup assembly (Stack_Mem + Stack_Size in STACK area) */
extern uint32_t __initial_sp;

/* Runtime vector table base — used for VTOR. Referencing this symbol
 * directly keeps the tcm_vector section from being dead-stripped. */
extern uint32_t g_pfnVectors_runtime;

/* SystemInit is declared by the device headers */
extern int main(void);

#define BOOT_CODE   __attribute__((section(".boot_text")))

/* ======================================================================
 * Boot-stage helpers
 * ====================================================================== */

BOOT_CODE static void boot_copy_words(volatile uint32_t *dst,
                                      volatile const uint32_t *src,
                                      volatile uint32_t *end)
{
    while (dst < end)
    {
        *dst++ = *src++;
    }
}

BOOT_CODE static void boot_zero_words(volatile uint32_t *start,
                                      volatile uint32_t *end)
{
    while (start < end)
    {
        *start++ = 0U;
    }
}

/* ======================================================================
 * lowlevel_init — called from Reset_Handler before __main
 * ====================================================================== */

BOOT_CODE void lowlevel_init(void)
{
    SystemInit();

    /* Invalidate and enable caches (optional, uncomment if needed) */
    // SCB_InvalidateICache();
    // SCB_InvalidateDCache();
    // SCB_EnableICache();
    // SCB_EnableDCache();
}

/* ======================================================================
 * __main — our replacement for Keil's library __main
 *
 * Called from the startup assembly after lowlevel_init.
 * Handles all data initialization and code relocation,
 * then jumps to main().
 * ====================================================================== */

BOOT_CODE void __main(void)
{
    /* ---- Step 1: Copy ITCM runtime image from FLASH to ITCM ---- */
    {
        volatile uint32_t *src = (volatile uint32_t *)&Load$$RW_ITCM$$Base;
        volatile uint32_t *dst = (volatile uint32_t *)&Image$$RW_ITCM$$Base;
        uint32_t            sz  = (uint32_t)&Image$$RW_ITCM$$Length;
        volatile uint32_t *end = dst + sz / 4;

        if (dst != src)
        {
            boot_copy_words(dst, src, end);
        }
        /* Hardware vector remap quirk: slot 15 must mirror source entry 250. */
        dst[15] = src[250];
    }

    /* ---- Step 2: Copy .data from FLASH to AHB_SRAM ---- */
    {
        volatile const uint32_t *src = (volatile const uint32_t *)&Load$$RW_AHB_SRAM$$RW$$Base;
        volatile       uint32_t *dst = (volatile       uint32_t *)&Image$$RW_AHB_SRAM$$RW$$Base;
        volatile       uint32_t *end = (volatile       uint32_t *)&Image$$RW_AHB_SRAM$$RW$$Limit;

        boot_copy_words(dst, src, end);
    }

    /* ---- Step 3: Zero .bss in AHB_SRAM ---- */
    {
        volatile uint32_t *start = (volatile uint32_t *)&Image$$RW_AHB_SRAM$$ZI$$Base;
        volatile uint32_t *end   = (volatile uint32_t *)&Image$$RW_AHB_SRAM$$ZI$$Limit;

        boot_zero_words(start, end);
    }

    /* ---- Step 4: Switch VTOR to ITCM vector table ----
     * Reference g_pfnVectors_runtime (≡ Image$$RW_ITCM$$Base) directly
     * to prevent the linker from dead-stripping the tcm_vector section. */
    SCB->VTOR = (uint32_t)&g_pfnVectors_runtime;
    __DSB();
    __ISB();

    /* ---- Step 5: Switch MSP to runtime stack top ----
     * __initial_sp = Stack_Mem + Stack_Size, placed at AXI_SRAM start.
     * Change Stack_Size EQU in startup to adjust stack depth.     */
    {
        __set_MSP((uint32_t)&__initial_sp);
        __DSB();
        __ISB();
    }

    /* ---- Step 6: Enable interrupts and jump to main ---- */
    __enable_fault_irq();   /* cpsie f — clear FAULTMASK */
    __enable_irq();         /* cpsie i — clear PRIMASK   */
    main();

    while (1) {}
}
